## dts/bindings/sensor/pixart,pmw3389.yaml
```yaml
# Copyright (c) 2022 Team Spatzenhirn
# SPDX-License-Identifier: Apache-2.0


description: |
  Motion Sensor

compatible: "pixart,pmw3389"

include: spi-device.yaml

properties:
  resolution:
    type: int
    required: false 
    description: |
      Resolution in counts per inch, multiples of 50, from 50 to 16000
  irq-gpios:
    type: phandle-array
    required: false
```
